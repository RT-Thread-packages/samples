## Kconfig
```kconfig
menu "RT-Thread Sample Configuration"

source "$BSP_DIR/packages/rt-thread-sample/kernel/Kconfig"

endmenu
```

## kernel/Kconfig
```kconfig
menu "Kernel Samples"

config PKG_USING_SAMPLE_BASIC
    bool "Select basic sample"
    default n

config PKG_USING_SAMPLE_THREAD_CREAT
    bool "Select thread create sample"
    default n

endmenu
```
